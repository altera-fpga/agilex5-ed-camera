/*
* Add this piece of dtsi fragment in the file socfpga_agilex5_socdk.dts
* Compile it in the kernel along with socfpga_agilex5.dtsi
* LW bridge starts on 0x2000_0000
* Full bridge starts on 0x4000_0000
*/

/{
	reserved-memory {

		overlay_fb_reserved: overlay_fb@86000000 {
			#address-cells = <2>;
			#size-cells = <2>;
			ranges; // Maps child addresses to physical address space
			reg = <0x0 0x86000000 0x0 0x02000000>;
			alignment = <0x1000>;
			no-map;
		};
	};	

/* Following generated by vfr_drm_ocs2dto.sh
	framebuffer0: framebuffer@0 {
		#address-cells = <2>;
		#size-cells = <2>;
		ranges;
		compatible = "altera,vfr-drm";
		reg = <0 0x88000000 0 0x02000000>,
			  <0 0x40800a00 0 0x00000010>,
			  <0 0x40501800 0 0x00000200>,
			  <0 0x40800a10 0 0x00000010>,
			  <0 0x40500c00 0 0x00000200>;
		reg-names = "framebuffer", "ase-overlay", "vfr-overlay", "ase-primary", "vfr-primary";
		memory-region = <&overlay_fb_reserved>;
		interrupt-parent = <&intc>;
		interrupts = <0 51 4>, <0 52 4>;
		status = "okay";
	};
*/
};
