## sw/meta-vvp-isp-demo/conf/layer.conf
```bitbake
BBPATH .= ":${LAYERDIR}"

BBFILES += "${LAYERDIR}/recipes-*/*.bb"
BBFILES += "${LAYERDIR}/recipes-*/*/*.bb"
BBFILES += "${LAYERDIR}/recipes-*/*/*.bbappend"

BBFILE_COLLECTIONS += "meta-vvp-isp-demo"
BBFILE_PATTERN_meta-vvp-isp-demo = "^${LAYERDIR}/"
BBFILE_PRIORITY_meta-vvp-isp-demo = "7"

LAYERDEPENDS_meta-vvp-isp-demo = "core"
LAYERSERIES_COMPAT_meta-vvp-isp-demo = "nanbield scarthgap"

WKS_FILE="vvp-isp-demo-image.wks"

# IMAGE_BOOT_FILES defaults set in meta-altera-bsp/conf/machine/include/socfpga-boot.inc
```

## sw/meta-vvp-isp-demo/conf/machine/agilex5_modular.conf
```bitbake
require conf/machine/agilex5_mk_a5e065bb32aea.conf

MACHINEOVERRIDES:prepend = "agilex5_mk_a5e065bb32aea:"
```

## sw/meta-vvp-isp-demo/wic/vvp-isp-demo-image.wks
```
part /mnt/boot --source bootimg-partition --ondisk mmcblk0 --fstype=vfat --mkfs-extraopts "-F 32" --label boot --active --align 1024 --fixed-size 250M --system-id b
part / --source rootfs --ondisk mmcblk0 --fstype=ext4 --label root --align 1024 --fixed-size 1024M
```
