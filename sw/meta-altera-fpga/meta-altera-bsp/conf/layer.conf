## sw/meta-altera-fpga/meta-altera-bsp/conf/layer.conf
```bitbake
# We have a conf and classes directory, append to BBPATH
BBPATH .= ":${LAYERDIR}"

# We have a recipes directory, add to BBFILES
BBFILES += "${LAYERDIR}/recipes*/*/*.bb ${LAYERDIR}/recipes*/*/*.bbappend"

BBFILE_COLLECTIONS += "altera-bsp-layer"
BBFILE_PATTERN_altera-bsp-layer := "^${LAYERDIR}/"
BBFILE_PRIORITY_altera-bsp-layer = "10"

# This should only be incremented on significant changes that will
# cause compatibility issues with other layers
LAYERVERSION_altera-bsp-layer = "1"
LAYERSERIES_COMPAT_altera-bsp-layer = "scarthgap"
LAYERDEPENDS_altera-bsp-layer = " \
    core \
"

ERROR_QA:remove:pn-linux-socfpga-rt = "patch-status"
```

## sw/meta-altera-fpga/meta-altera-bsp/conf/machine/include/agilex.inc
```bitbake
KERNEL_IMAGETYPE ?= "Image"
KERNEL_CLASSES:append = " kernel-fitimage"
SOCFPGA_FEATURES ?= "jffs2 gpio_sys usb_adapter"

KBUILD_DEFCONFIG ?= "defconfig"

SPL_BINARY ?= "spl/u-boot-spl-dtb.hex"

UBOOT_ENTRYPOINT ?= "0x4000000"
UBOOT_LOADADDRESS ?= "0x4000000"
UBOOT_ELF ?= "u-boot"
UBOOT_BINARY ?= "u-boot.itb"
UBOOT_SUFFIX ?= "itb"

FIT_KERNEL_COMP_ALG = "none"

EXTRA_IMAGECMD:jffs2 ?= "-n -q -e 0x10000"

SERIAL_CONSOLES ?= "115200;ttyS0"

IMAGE_FSTYPES ?= "cpio ext4 wic.gz wic.bmap"
WKS_FILE ?= "sdimage-agilex.wks.in"
```

## sw/meta-altera-fpga/meta-altera-bsp/conf/machine/include/agilex3.inc
```bitbake
require conf/machine/include/arm/arch-armv8-2a.inc
require conf/machine/include/socfpga.inc
require conf/machine/include/agilex.inc

ATF_PLAT ?= "agilex3"
DTS_NAME ??= "socfpga_agilex3_socdk"

KERNEL_DEVICETREE ?= "intel/${DTS_NAME}.dtb"

# BOOT
require conf/machine/include/socfpga-boot.inc
IMAGE_BOOT_ARGS:append = " console=ttyS0,115200 init=/sbin/init"

# UBIFS
UBIFS_LEB_SIZE = "1032192"
UBIFS_LEB_CNT = "8500"
UBIFS_PEB_SIZE = "1024"
PAGE_SIZE = "8192"

require conf/machine/include/ubifs.inc
```

## sw/meta-altera-fpga/meta-altera-bsp/conf/machine/include/agilex5.inc
```bitbake
require conf/machine/include/arm/arch-armv8-2a.inc
require conf/machine/include/socfpga.inc
require conf/machine/include/agilex.inc

ATF_PLAT ?= "agilex5"
DTS_NAME ??= "socfpga_agilex5_socdk"

SOCFPGA_FEATURES:append = " agilex5"

# BOOT
require conf/machine/include/socfpga-boot.inc
IMAGE_BOOT_ARGS:append = " console=ttyS0,115200 init=/sbin/init"

# UBIFS
UBIFS_LEB_SIZE = "1032192"
UBIFS_LEB_CNT = "8500"
UBIFS_PEB_SIZE = "1024"
PAGE_SIZE = "8192"

require conf/machine/include/ubifs.inc
```

## sw/meta-altera-fpga/meta-altera-bsp/conf/machine/include/agilex7.inc
```bitbake
require conf/machine/include/arm/arch-armv8a.inc
require conf/machine/include/socfpga.inc
require conf/machine/include/agilex.inc

ATF_PLAT ?= "agilex"
DTS_NAME ??= "socfpga_agilex_socdk"

KERNEL_DEVICETREE ?= "intel/${DTS_NAME}.dtb"

# BOOT
require conf/machine/include/socfpga-boot.inc

# UBIFS
UBIFS_LEB_SIZE = "126976"
UBIFS_LEB_CNT = "7800"
UBIFS_PEB_SIZE = "128"
PAGE_SIZE = "2048"

require conf/machine/include/ubifs.inc
```

## sw/meta-altera-fpga/meta-altera-bsp/conf/machine/include/socfpga-boot.inc
```bitbake
MACHINE_ESSENTIAL_EXTRA_RDEPENDS += "\
    device-tree \
    ${@ 'fpga-bitstream' if "bitstream" in d.getVar('SOCFPGA_FEATURES') else ''}"

IMAGE_BOOT_ARGS ?= "earlycon panic=-1"

# Add variables for wic creation of sdcard image
IMAGE_BOOT_FILES ?= " \
			${UBOOT_BINARY} \
			Image \
			boot.scr.uimg \
			devicetree/${DTS_NAME}.dtb;${DTS_NAME}.dtb \
			${@ 'top.core.rbf' if "bitstream" in d.getVar('SOCFPGA_FEATURES') else ''}"
```

## sw/meta-altera-fpga/meta-altera-bsp/conf/machine/include/socfpga.inc
```bitbake
SOC_FAMILY = "socfpga"

KERNEL_PROVIDER ?= "linux-socfpga"
PREFERRED_PROVIDER_virtual/kernel ?= "${KERNEL_PROVIDER}"

PREFERRED_PROVIDER_virtual/bootloader ?= "u-boot-socfpga"
PREFERRED_PROVIDER_u-boot ?= "u-boot-socfpga"

PREFERRED_PROVIDER_u-boot-default-script ?= "socfpga-u-boot-scr"

MACHINE_EXTRA_RRECOMMENDS = " kernel-modules"

IMAGE_TYPE ??= "mmc"

do_image_wic[depends] += "mtools-native:do_populate_sysroot dosfstools-native:do_populate_sysroot virtual/bootloader:do_deploy virtual/kernel:do_deploy"
```

## sw/meta-altera-fpga/meta-altera-bsp/conf/machine/include/ubifs.inc
```bitbake
# Settings for ubifs
MKUBIFS_ARGS ?= "--leb-size ${UBIFS_LEB_SIZE} --min-io-size ${PAGE_SIZE} --max-leb-cnt ${UBIFS_LEB_CNT}"
UBINIZE_ARGS ?= "--peb-size ${UBIFS_PEB_SIZE}KiB --min-io-size ${PAGE_SIZE} --sub-page-size ${PAGE_SIZE}"
MULTIUBI_BUILD += "nand"
MKUBIFS_ARGS_nand ?= "--leb-size ${UBIFS_LEB_SIZE} --min-io-size ${PAGE_SIZE} --max-leb-cnt ${UBIFS_LEB_CNT}"
UBINIZE_ARGS_nand ?= "--peb-size ${UBIFS_PEB_SIZE}KiB --min-io-size ${PAGE_SIZE} --sub-page-size ${PAGE_SIZE}"
MULTIUBI_BUILD += "nor"
MKUBIFS_ARGS_nor ?= "-F -e 65408 -m 1 -c ${UBIFS_LEB_CNT}"
UBINIZE_ARGS_nor ?= "-p 65536 -m 1 -s 1"
```

## sw/meta-altera-fpga/meta-altera-core/conf/layer.conf
```bitbake
# We have a conf and classes directory, append to BBPATH
BBPATH .= ":${LAYERDIR}"

# We have a recipes directory, add to BBFILES
BBFILES += "${LAYERDIR}/recipes*/*/*.bb ${LAYERDIR}/recipes*/*/*.bbappend"

BBFILE_COLLECTIONS += "altera-core-layer"
BBFILE_PATTERN_altera-core-layer := "^${LAYERDIR}/"
BBFILE_PRIORITY_altera-core-layer = "10"

BBFILES_DYNAMIC += " \
    virtualization-layer:${LAYERDIR}/dynamic-layers/virtualization-layer/*/*/*.bb \
    virtualization-layer:${LAYERDIR}/dynamic-layers/virtualization-layer/*/*/*.bbappend \
    intel-realsense:${LAYERDIR}/dynamic-layers/intel-realsense/*/*/*.bb \
    intel-realsense:${LAYERDIR}/dynamic-layers/intel-realsense/*/*/*.bbappend \
"

# This should only be incremented on significant changes that will
# cause compatibility issues with other layers
LAYERVERSION_altera-core-layer = "1"
LAYERSERIES_COMPAT_altera-core-layer = "scarthgap"
LAYERDEPENDS_altera-core-layer = " \
    core \
    altera-bsp-layer \
"
```

## sw/meta-altera-fpga/meta-altera-devkit/conf/layer.conf
```bitbake
# We have a conf and classes directory, append to BBPATH
BBPATH .= ":${LAYERDIR}"

BBFILE_COLLECTIONS += "altera-devkit-layer"
BBFILE_PATTERN_altera-devkit-layer := "^${LAYERDIR}/"
BBFILE_PRIORITY_altera-devkit-layer = "10"

# This should only be incremented on significant changes that will
# cause compatibility issues with other layers
LAYERVERSION_altera-devkit-layer = "1"
LAYERSERIES_COMPAT_altera-devkit-layer = "scarthgap"
LAYERDEPENDS_altera-devkit-layer = " \
    core \
    altera-bsp-layer \
"
```

## sw/meta-altera-fpga/meta-altera-devkit/conf/machine/agilex5_mk_a5e065bb32aea.conf
```bitbake
#@TYPE: Machine
#@NAME: Intel SoCFPGA Agilex5
#@DESCRIPTION: Machine configuration for the Agilex5 SoCFPGA

DTS_NAME ?= "socfpga_agilex5_socdk_modular"

UBOOT_CONFIG ??= "agilex5-socdk-atf"
UBOOT_CONFIG[agilex5-socdk-atf] = "socfpga_agilex5_modular_defconfig"

require conf/machine/include/agilex5.inc
```

## sw/meta-altera-fpga/meta-altera-devkit/conf/machine/include/agilex5-devkit.inc
```bitbake
DTS_NAME ?= "socfpga_agilex5_socdk"

UBOOT_CONFIG ??= "agilex5-socdk-atf"
UBOOT_CONFIG[agilex5-socdk-atf] = "socfpga_agilex5_defconfig"

require conf/machine/include/agilex5.inc
```
